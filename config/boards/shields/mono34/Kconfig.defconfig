## config/boards/shields/mono34/Kconfig.defconfig
```kconfig
# SPDX-License-Identifier: MIT

if SHIELD_MONO34

config ZMK_KEYBOARD_NAME
    default "mono34"

endif
```

## config/boards/shields/mono34/Kconfig.shield
```kconfig
# SPDX-License-Identifier: MIT

config SHIELD_MONO34
    def_bool $(shields_list_contains,mono34)
```
